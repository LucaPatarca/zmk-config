## config/boards/shields/fma/Kconfig.defconfig
```kconfig
config ZMK_BLE
    default y

config ZMK_USB
    default y

if SHIELD_FMA_LEFT

config ZMK_KEYBOARD_NAME
    default "FMA Keyboard"

config ZMK_SPLIT_ROLE_CENTRAL
    default y

endif

if SHIELD_FMA_LEFT || SHIELD_FMA_RIGHT

config ZMK_SPLIT
    default y

endif
```

## config/boards/shields/fma/Kconfig.shield
```kconfig
config SHIELD_FMA_LEFT
    def_bool $(shields_list_contains,fma_left)

config SHIELD_FMA_RIGHT
    def_bool $(shields_list_contains,fma_right)
```

## config/west.yml
```yaml
manifest:
  remotes:
    - name: LucaPatarca
      url-base: https://github.com/LucaPatarca
  projects:
    - name: zmk
      remote: LucaPatarca
      revision: main
      import: app/west.yml
  self:
    path: config
```
